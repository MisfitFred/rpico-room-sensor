## components/sensor_reader/tests/testcase.yaml
```yaml
tests:
  components.sensor_reader:
    tags: sensor_reader
    platform_allow:
      - native_sim
      - native_sim/native/64
    timeout: 60
```
